## panels/firmware/main/Kconfig.projbuild
```kconfig
menu "Desk panel"
    config PANEL_HUB_URL
        string "Hub address"
        default "http://192.168.1.10:8083"
    config PANEL_WIFI_SSID
        string "Wi-Fi network"
        default ""
    config PANEL_WIFI_PASSWORD
        string "Wi-Fi password"
        default ""
endmenu
```
